## conf/distro/speedy.conf
```bitbake
# A speedy distro

require conf/distro/fsl-imx-x11.conf

DISTRO = "speedy"
DISTRO_NAME = "SPEEDY"

DISTRO_VERSION = "1.0"
DISTRO_CODENAME = "Norbit"

SDK_VENDOR = "-jang"
SDK_VERSION := "${@'${DISTRO_VERSION}'.replace('snapshot-${DATE}','snapshot')}"

MAINTAINER = "jang <jangbogo@terranova.ar>"

#DISTRO_FEATURES_append = " systemd"
#DISTRO_FEATURES_remove = "foo"
```

## conf/layer.conf
```bitbake
# We have a conf and classes directory, add to BBPATH
BBPATH .= ":${LAYERDIR}"

# We have recipes-* directories, add to BBFILES
BBFILES += "${LAYERDIR}/recipes-*/*/*.bb \
            ${LAYERDIR}/recipes-*/*/*.bbappend"

BBFILE_COLLECTIONS += "meta-phor"
BBFILE_PATTERN_meta-phor = "^${LAYERDIR}/"
BBFILE_PRIORITY_meta-phor = "6"

LAYERSERIES_COMPAT_meta-phor = "sumo"
```
